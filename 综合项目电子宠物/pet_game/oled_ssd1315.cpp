/**
 * @file    oled_ssd1315.cpp
 * @brief   SSD1315/SSD1306 OLED 裸驱动实现
 */

extern "C" {
#include "oled_ssd1315.h"
}

#include <Arduino.h>
#include <Wire.h>
#include <string.h>
#include <stdarg.h>
#include <stdio.h>

/* ============================================================
 * 内部状态
 * ============================================================ */
static uint8_t s_addr = 0;
static uint8_t s_buffer[OLED_BUF_SIZE];

/* ============================================================
 * 6×8 ASCII 字体 (空格~z, 95 字符)
 * ============================================================ */
static const uint8_t PROGMEM font_6x8[][6] = {
    {0x00,0x00,0x00,0x00,0x00,0x00}, // ' '
    {0x00,0x00,0x5F,0x00,0x00,0x00}, // '!'
    {0x00,0x07,0x00,0x07,0x00,0x00}, // '"'
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    {0x44,0x64,0x54,0x4C,0x44,0x00}, // 'z'
};

/* ============================================================
 * I2C 底层通信
 * ============================================================ */
static void send_cmd(uint8_t cmd)
{
    Wire.beginTransmission(s_addr);
    Wire.write(0x00);
    Wire.write(cmd);
    Wire.endTransmission();
}

static void send_cmd2(uint8_t cmd, uint8_t val)
{
    Wire.beginTransmission(s_addr);
    Wire.write(0x00);
    Wire.write(cmd);
    Wire.write(val);
    Wire.endTransmission();
}

/* ============================================================
 * 初始化 & 控制
 * ============================================================ */
extern "C" void oled_init(uint8_t sda, uint8_t scl, uint32_t i2c_freq, uint8_t addr)
{
    s_addr = addr;
    Wire.begin(sda, scl, i2c_freq);
    delay(1);

    send_cmd(0xAE);
    send_cmd2(0xA8, 0x3F);
    send_cmd2(0xD3, 0x00);
    send_cmd(0x40);
    send_cmd(0xA1);
    send_cmd(0xC8);
    send_cmd2(0xDA, 0x12);
    send_cmd2(0xD5, 0xF0);
    send_cmd2(0x81, 0xB0);
    send_cmd2(0xD9, 0xF1);
    send_cmd2(0xDB, 0x30);
    send_cmd2(0x8D, 0x14);
    send_cmd2(0x20, 0x00);
    send_cmd(0xA4);
    send_cmd(0xA6);

    memset(s_buffer, 0x00, sizeof(s_buffer));
    oled_flush();

    delay(100);
    send_cmd(0xAF);
}

extern "C" void oled_flush(void)
{
    send_cmd(0x21); send_cmd(0x00); send_cmd(0x7F);
    send_cmd(0x22); send_cmd(0x00); send_cmd(0x07);

    for (uint8_t page = 0; page < OLED_PAGES; page++) {
        Wire.beginTransmission(s_addr);
        Wire.write(0x40);
        Wire.write(&s_buffer[page * OLED_WIDTH], 64);
        Wire.endTransmission();

        Wire.beginTransmission(s_addr);
        Wire.write(0x40);
        Wire.write(&s_buffer[page * OLED_WIDTH + 64], 64);
        Wire.endTransmission();
    }
}

extern "C" void oled_clear(void)
{
    memset(s_buffer, 0x00, sizeof(s_buffer));
}

extern "C" void oled_fill(void)
{
    memset(s_buffer, 0xFF, sizeof(s_buffer));
}

extern "C" void oled_set_contrast(uint8_t contrast)
{
    send_cmd2(0x81, contrast);
}

extern "C" void oled_display_on(bool on)
{
    send_cmd(on ? 0xAF : 0xAE);
}

extern "C" void oled_invert(bool invert)
{
    send_cmd(invert ? 0xA7 : 0xA6);
}

/* ============================================================
 * 像素级绘图
 * ============================================================ */
extern "C" void oled_pixel(uint8_t x, uint8_t y, bool on)
{
    if (x >= OLED_WIDTH || y >= OLED_HEIGHT) return;
    uint16_t idx = (y / 8) * OLED_WIDTH + x;
    if (on) s_buffer[idx] |=  (1 << (y & 7));
    else    s_buffer[idx] &= ~(1 << (y & 7));
}

extern "C" void oled_hline(uint8_t x0, uint8_t x1, uint8_t y)
{
    for (uint8_t x = x0; x <= x1 && x < OLED_WIDTH; x++)
        oled_pixel(x, y, true);
}

extern "C" void oled_vline(uint8_t x, uint8_t y0, uint8_t y1)
{
    for (uint8_t y = y0; y <= y1 && y < OLED_HEIGHT; y++)
        oled_pixel(x, y, true);
}

extern "C" void oled_rect(uint8_t x, uint8_t y, uint8_t w, uint8_t h)
{
    oled_hline(x, x + w - 1, y);
    oled_hline(x, x + w - 1, y + h - 1);
    oled_vline(x, y, y + h - 1);
    oled_vline(x + w - 1, y, y + h - 1);
}

extern "C" void oled_fill_rect(uint8_t x, uint8_t y, uint8_t w, uint8_t h)
{
    for (uint8_t row = y; row < y + h && row < OLED_HEIGHT; row++)
        for (uint8_t col = x; col < x + w && col < OLED_WIDTH; col++)
            oled_pixel(col, row, true);
}

/* ============================================================
 * 文字绘制
 * ============================================================ */
extern "C" void oled_char(uint8_t x, uint8_t page, char ch)
{
    if (ch < 32 || ch > 'z') ch = ' ';
    uint8_t idx = ch - 32;
    uint16_t base = page * OLED_WIDTH + x;

    for (uint8_t col = 0; col < 6 && (x + col) < OLED_WIDTH; col++)
        s_buffer[base + col] = pgm_read_byte(&font_6x8[idx][col]);
}

extern "C" void oled_str(uint8_t x, uint8_t page, const char *str)
{
    while (*str && x < OLED_WIDTH) {
        oled_char(x, page, *str++);
        x += 6;
    }
}

extern "C" void oled_char_2x(uint8_t x, uint8_t page, char ch)
{
    if (ch < 32 || ch > 'z') ch = ' ';
    if (page >= OLED_PAGES - 1) return;
    uint8_t idx = ch - 32;

    for (uint8_t col = 0; col < 6; col++) {
        uint8_t src = pgm_read_byte(&font_6x8[idx][col]);
        uint16_t stretched = 0;
        for (uint8_t bit = 0; bit < 8; bit++) {
            if (src & (1 << bit))
                stretched |= (3 << (bit * 2));
        }
        uint8_t x_pos = x + col * 2;
        if (x_pos + 1 < OLED_WIDTH) {
            s_buffer[page * OLED_WIDTH + x_pos]           = (uint8_t)(stretched & 0xFF);
            s_buffer[page * OLED_WIDTH + x_pos + 1]       = (uint8_t)(stretched & 0xFF);
            s_buffer[(page + 1) * OLED_WIDTH + x_pos]     = (uint8_t)(stretched >> 8);
            s_buffer[(page + 1) * OLED_WIDTH + x_pos + 1] = (uint8_t)(stretched >> 8);
        }
    }
}

extern "C" void oled_str_2x(uint8_t x, uint8_t page, const char *str)
{
    while (*str && x < OLED_WIDTH) {
        oled_char_2x(x, page, *str++);
        x += 12;
    }
}

extern "C" void oled_printf(uint8_t x, uint8_t page, const char *fmt, ...)
{
    char buf[32];
    va_list args;
    va_start(args, fmt);
    vsnprintf(buf, sizeof(buf), fmt, args);
    va_end(args);
    oled_str(x, page, buf);
}

extern "C" void oled_printf_2x(uint8_t x, uint8_t page, const char *fmt, ...)
{
    char buf[22];
    va_list args;
    va_start(args, fmt);
    vsnprintf(buf, sizeof(buf), fmt, args);
    va_end(args);
    oled_str_2x(x, page, buf);
}

/* ============================================================
 * 进度条
 * ============================================================ */
extern "C" void oled_progress_bar(uint8_t x, uint8_t y, uint8_t w, uint8_t h,
                                  float percent)
{
    if (percent < 0.0f) percent = 0.0f;
    if (percent > 1.0f) percent = 1.0f;

    oled_rect(x, y, w, h);

    uint8_t fill_w = (uint8_t)((w - 4) * percent);
    for (uint8_t row = y + 2; row < y + h - 2; row++)
        for (uint8_t col = x + 2; col < x + 2 + fill_w; col++)
            oled_pixel(col, row, true);
}

extern "C" uint8_t *oled_get_buffer(void)
{
    return s_buffer;
}
